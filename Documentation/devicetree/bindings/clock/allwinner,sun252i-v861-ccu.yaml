## Documentation/devicetree/bindings/clock/allwinner,sun252i-v861-ccu.yaml
```yaml
# SPDX-License-Identifier: (GPL-2.0-only OR BSD-2-Clause)
%YAML 1.2
---
$id: http://devicetree.org/schemas/clock/allwinner,sun252i-v861-ccu.yaml#
$schema: http://devicetree.org/meta-schemas/core.yaml#

title: Allwinner V861 clock control units

maintainers:
  - Han Gao <gaohan@iscas.ac.cn>

properties:
  compatible:
    enum:
      - allwinner,sun252i-v861-ccu
      - allwinner,sun252i-v861-r-ccu
      - allwinner,sun252i-v861-rtc-ccu

  reg:
    maxItems: 1

  '#clock-cells':
    const: 1

  '#reset-cells':
    const: 1

  clocks:
    minItems: 2
    maxItems: 4

  clock-names:
    minItems: 2
    maxItems: 4

required:
  - compatible
  - reg
  - '#clock-cells'
  - clocks
  - clock-names

allOf:
  - if:
      properties:
        compatible:
          const: allwinner,sun252i-v861-ccu
    then:
      properties:
        clocks:
          items:
            - description: 24 MHz oscillator
            - description: Low-speed oscillator
            - description: Internal oscillator
        clock-names:
          items:
            - const: hosc
            - const: losc
            - const: iosc
      required:
        - '#reset-cells'

  - if:
      properties:
        compatible:
          const: allwinner,sun252i-v861-r-ccu
    then:
      properties:
        clocks:
          items:
            - description: 24 MHz oscillator
            - description: Low-speed oscillator
            - description: Internal oscillator
            - description: Peripheral PLL 200 MHz output
        clock-names:
          items:
            - const: hosc
            - const: losc
            - const: iosc
            - const: pll-periph
      required:
        - '#reset-cells'

  - if:
      properties:
        compatible:
          const: allwinner,sun252i-v861-rtc-ccu
    then:
      properties:
        '#reset-cells': false
        clocks:
          items:
            - description: Internal 16 MHz oscillator
            - description: External 32768 Hz oscillator
            - description: 24 MHz oscillator
        clock-names:
          items:
            - const: iosc
            - const: ext-osc32k
            - const: hosc

additionalProperties: false

examples:
  - |
    #include <dt-bindings/clock/sun252i-v861-rtc-ccu.h>

    clock-controller@2001000 {
        compatible = "allwinner,sun252i-v861-ccu";
        reg = <0x02001000 0x1000>;
        clocks = <&hosc>, <&rtc_ccu CLK_RTC_LOSC>,
                 <&rtc_ccu CLK_RTC_IOSC>;
        clock-names = "hosc", "losc", "iosc";
        #clock-cells = <1>;
        #reset-cells = <1>;
    };
```

## Documentation/devicetree/bindings/clock/zhihe,a210-aon-clk.yaml
```yaml
# SPDX-License-Identifier: (GPL-2.0-only OR BSD-2-Clause)
%YAML 1.2
---
$id: http://devicetree.org/schemas/clock/zhihe,a210-aon-clk.yaml#
$schema: http://devicetree.org/meta-schemas/core.yaml#

title: Zhihe A210 always-on peripheral clock controller

maintainers:
  - Han Gao <gaohan@iscas.ac.cn>

description: |
  E902 firmware selects the AON source and divider. The application
  processor reads that selection and controls the separate I2C1 gates.
  The PMIC I2C0 and E902 clocks remain owned by the firmware.

properties:
  compatible:
    const: zhihe,a210-aon-clk

  reg:
    maxItems: 1

  clocks:
    items:
      - description: High-speed AON reference
      - description: External oscillator
      - description: Internal RC oscillator
      - description: RTC oscillator

  clock-names:
    items:
      - const: high
      - const: osc
      - const: rc
      - const: rtc

  '#clock-cells':
    const: 1

required:
  - compatible
  - reg
  - clocks
  - clock-names
  - '#clock-cells'

additionalProperties: false

examples:
  - |
    clock-controller@30844000 {
        compatible = "zhihe,a210-aon-clk";
        reg = <0x30844000 0x1c>;
        clocks = <&aon_high>, <&osc24m>, <&rc26m>, <&rtc32k>;
        clock-names = "high", "osc", "rc", "rtc";
        #clock-cells = <1>;
    };
...
```

## Documentation/devicetree/bindings/iio/adc/thead,th1520-adc.yaml
```yaml
# SPDX-License-Identifier: (GPL-2.0-only OR BSD-2-Clause)
%YAML 1.2
---
$id: http://devicetree.org/schemas/iio/adc/thead,th1520-adc.yaml#
$schema: http://devicetree.org/meta-schemas/core.yaml#

title: T-Head TH1520 and Zhihe A210 ADC

maintainers:
  - Han Gao <gaohan@iscas.ac.cn>

description:
  A 12-bit ADC with eight inputs on TH1520 and four inputs on A210.

properties:
  compatible:
    enum:
      - thead,th1520-adc
      - zhihe,a210-adc
  reg:
    maxItems: 1
  clocks:
    maxItems: 1
  resets:
    maxItems: 1
  interrupts:
    maxItems: 1
  power-domains:
    maxItems: 1
  vref-supply:
    description: External analog reference voltage.
  '#io-channel-cells':
    const: 1

required:
  - compatible
  - reg
  - clocks
  - resets
  - vref-supply
  - '#io-channel-cells'

additionalProperties: false

examples:
  - |
    adc@5a0000 {
        compatible = "zhihe,a210-adc";
        reg = <0x5a0000 0x1000>;
        clocks = <&clk 1>;
        resets = <&rst 1>;
        vref-supply = <&vref>;
        #io-channel-cells = <1>;
    };
...
```

## Documentation/devicetree/bindings/pci/zhihe,a210-pcie.yaml
```yaml
# SPDX-License-Identifier: (GPL-2.0-only OR BSD-2-Clause)
%YAML 1.2
---
$id: http://devicetree.org/schemas/pci/zhihe,a210-pcie.yaml#
$schema: http://devicetree.org/meta-schemas/core.yaml#

title: Zhihe A210 DesignWare PCIe root port

maintainers:
  - Han Gao <gaohan@iscas.ac.cn>

allOf:
  - $ref: /schemas/pci/snps,dw-pcie.yaml#

properties:
  compatible:
    const: zhihe,a210-pcie

  reg:
    items:
      - description: DesignWare DBI registers
      - description: Downstream configuration window
      - description: A210 application registers

  reg-names:
    items:
      - const: dbi
      - const: config
      - const: app

  clocks:
    items:
      - description: Auxiliary clock
      - description: AXI slave clock
      - description: AXI master clock
      - description: APB register clock

  clock-names:
    items:
      - const: aux
      - const: slv
      - const: mstr
      - const: dbi

  resets:
    items:
      - description: APB interface reset
      - description: Controller power-up reset

  reset-names:
    items:
      - const: dbi
      - const: pwr

  interrupts:
    maxItems: 1

  interrupt-names:
    const: msi

  power-domains:
    maxItems: 1

  phys:
    maxItems: 1

  phy-names:
    const: pcie

  num-lanes:
    enum: [1, 2, 4]

  max-link-speed:
    maximum: 3

  reset-gpios:
    maxItems: 1

  vpcie3v3-supply:
    description: Endpoint 3.3 V supply

  vpcie1v5-supply:
    description: Endpoint 1.5 V supply, when present

  vpcie12v-supply:
    description: Endpoint 12 V supply, when present

required:
  - compatible
  - reg
  - reg-names
  - clocks
  - clock-names
  - resets
  - reset-names
  - interrupts
  - interrupt-names
  - power-domains
  - phys
  - phy-names
  - num-lanes

unevaluatedProperties: false

examples:
  - |
    #include <dt-bindings/interrupt-controller/irq.h>
    pcie@b000000 {
        compatible = "zhihe,a210-pcie";
        reg = <0xb000000 0x800000>, <0x40000000 0x100000>,
              <0xa004000 0x1000>;
        reg-names = "dbi", "config", "app";
        device_type = "pci";
        #address-cells = <3>;
        #size-cells = <2>;
        #interrupt-cells = <1>;
        bus-range = <0 255>;
        ranges = <0x02000000 0 0x40100000 0x40100000 0 0x800000>;
        interrupt-parent = <&plic>;
        interrupts = <139 IRQ_TYPE_LEVEL_HIGH>;
        interrupt-names = "msi";
        interrupt-map-mask = <0 0 0 7>;
        interrupt-map = <0 0 0 1 &plic 140 IRQ_TYPE_LEVEL_HIGH>,
                        <0 0 0 2 &plic 141 IRQ_TYPE_LEVEL_HIGH>,
                        <0 0 0 3 &plic 142 IRQ_TYPE_LEVEL_HIGH>,
                        <0 0 0 4 &plic 143 IRQ_TYPE_LEVEL_HIGH>;
        clocks = <&pcie_clk 0>, <&pcie_clk 1>, <&pcie_clk 2>,
                 <&pcie_clk 3>;
        clock-names = "aux", "slv", "mstr", "dbi";
        resets = <&pcie_rst 2>, <&pcie_rst 3>;
        reset-names = "dbi", "pwr";
        power-domains = <&pcie_power>;
        phys = <&e16>;
        phy-names = "pcie";
        num-lanes = <1>;
        max-link-speed = <3>;
    };
...
```

## Documentation/devicetree/bindings/phy/zhihe,a210-c10-phy.yaml
```yaml
# SPDX-License-Identifier: (GPL-2.0-only OR BSD-2-Clause)
%YAML 1.2
---
$id: http://devicetree.org/schemas/phy/zhihe,a210-c10-phy.yaml#
$schema: http://devicetree.org/meta-schemas/core.yaml#

title: Zhihe A210 Synopsys C10 USB3 PHY

maintainers:
  - Han Gao <gaohan@iscas.ac.cn>

description:
  USB3 PHY with an integrated Type-C lane crossbar. The Type-C port
  manager controls cable orientation through the standard switch API.

properties:
  compatible:
    const: zhihe,a210-c10-phy
  reg:
    maxItems: 1
    description: Type-C adaptation block registers.
  clocks:
    maxItems: 3
  clock-names:
    items:
      - const: apb
      - const: ref
      - const: suspend
  resets:
    maxItems: 2
  reset-names:
    items:
      - const: apb
      - const: phy
  power-domains:
    maxItems: 1
  '#phy-cells':
    const: 0
  orientation-switch:
    type: boolean
  port:
    $ref: /schemas/graph.yaml#/properties/port
    description: Connection to the USB-C connector superspeed port.

required:
  - compatible
  - reg
  - clocks
  - clock-names
  - resets
  - reset-names
  - power-domains
  - '#phy-cells'

additionalProperties: false

examples:
  - |
    phy@807c000 {
        compatible = "zhihe,a210-c10-phy";
        reg = <0x807c000 0x100>;
        clocks = <&clk 1>, <&clk 2>, <&clk 3>;
        clock-names = "apb", "ref", "suspend";
        resets = <&rst 1>, <&rst 2>;
        reset-names = "apb", "phy";
        power-domains = <&usb_power>;
        #phy-cells = <0>;
    };
...
```

## Documentation/devicetree/bindings/phy/zhihe,a210-e16-phy.yaml
```yaml
# SPDX-License-Identifier: (GPL-2.0-only OR BSD-2-Clause)
%YAML 1.2
---
$id: http://devicetree.org/schemas/phy/zhihe,a210-e16-phy.yaml#
$schema: http://devicetree.org/meta-schemas/core.yaml#

title: Zhihe A210 Synopsys E16 shared PCIe PHY

maintainers:
  - Han Gao <gaohan@iscas.ac.cn>

description: |
  Two analog PHY banks share lane routing and resistance calibration.
  Both PCIe root ports use the same PHY so initialization and clocks
  remain active until the last consumer releases it. SATA lanes may be
  reserved by the routing configuration; this binding describes the
  PCIe consumers of the shared block.

properties:
  compatible:
    const: zhihe,a210-e16-phy

  reg:
    items:
      - description: Common control registers
      - description: First analog PHY bank
      - description: Second analog PHY bank

  reg-names:
    items:
      - const: sysreg
      - const: phy0
      - const: phy1

  clocks:
    items:
      - description: APB register clock
      - description: External 100 MHz reference clock

  clock-names:
    items:
      - const: apb
      - const: ref

  resets:
    items:
      - description: APB interface reset
      - description: Common PHY reset

  reset-names:
    items:
      - const: apb
      - const: phy

  '#phy-cells':
    const: 0

  data-lanes:
    $ref: /schemas/types.yaml#/definitions/uint32-array
    description: |
      Destination of each of the four physical lanes, in lane order.
      0 is unused, 1 is PCIe port 0, 2 is PCIe port 1, and 3 and 4 are
      SATA ports 0 and 1. Supported routings are <1 1 1 1>, <1 1 2 0>,
      <1 1 3 4> and <1 2 3 4>.
    minItems: 4
    maxItems: 4
    items:
      minimum: 0
      maximum: 4

required:
  - compatible
  - reg
  - reg-names
  - clocks
  - clock-names
  - resets
  - reset-names
  - '#phy-cells'
  - data-lanes

additionalProperties: false

examples:
  - |
    phy@a180000 {
        compatible = "zhihe,a210-e16-phy";
        reg = <0xa180000 0x1000>, <0xa100000 0x40000>,
              <0xa140000 0x40000>;
        reg-names = "sysreg", "phy0", "phy1";
        clocks = <&pcie_clk 0>, <&pcie_ref>;
        clock-names = "apb", "ref";
        resets = <&pcie_rst 0>, <&pcie_rst 1>;
        reset-names = "apb", "phy";
        #phy-cells = <0>;
        data-lanes = <1 2 3 4>;
    };
...
```

## Documentation/devicetree/bindings/phy/zhihe,a210-usb2-phy.yaml
```yaml
# SPDX-License-Identifier: (GPL-2.0-only OR BSD-2-Clause)
%YAML 1.2
---
$id: http://devicetree.org/schemas/phy/zhihe,a210-usb2-phy.yaml#
$schema: http://devicetree.org/meta-schemas/core.yaml#

title: Zhihe A210 USB2 femtoPHY

maintainers:
  - Han Gao <gaohan@iscas.ac.cn>

description: |
  Each DWC2 controller has a dedicated USB2 PHY register bank. The PHY
  uses the connected controller's fixed dr_mode for its pull-downs.
  PHY1 places these controls at different bit positions from PHY0.
  The DWC3 companion PHY has a separate UTMI register bank and uses
  controller-managed role switching. Board VBUS switching belongs to
  the controller regulator or Type-C port manager, not the PHY.

properties:
  compatible:
    enum:
      - zhihe,a210-usb2-phy
      - zhihe,a210-usb2-phy1
      - zhihe,a210-usb31-usb2-phy
  reg:
    maxItems: 1
  clocks:
    maxItems: 1
  clock-names:
    const: apb
  resets:
    maxItems: 1
  reset-names:
    const: phy
  power-domains:
    maxItems: 1
  '#phy-cells':
    const: 0

required:
  - compatible
  - reg
  - clocks
  - clock-names
  - resets
  - reset-names
  - power-domains
  - '#phy-cells'

additionalProperties: false

examples:
  - |
    phy@8301000 {
        compatible = "zhihe,a210-usb2-phy1";
        reg = <0x8301000 0x20>;
        clocks = <&usb_clk 1>;
        clock-names = "apb";
        resets = <&usb_rst 1>;
        reset-names = "phy";
        power-domains = <&usb_power>;
        #phy-cells = <0>;
    };
...
```

## Documentation/devicetree/bindings/riscv/zhihe.yaml
```yaml
# SPDX-License-Identifier: (GPL-2.0-only OR BSD-2-Clause)
%YAML 1.2
---
$id: http://devicetree.org/schemas/riscv/zhihe.yaml#
$schema: http://devicetree.org/meta-schemas/core.yaml#

title: ZhiHe SoC-based boards

maintainers:
  - Zhiguo Zhu <zhiguo.zhu@linux.alibaba.com>

properties:
  $nodename:
    const: '/'
  compatible:
    oneOf:
      - description: Melon Pi V1 and V2 with the A210 SODIMM module
        items:
          - enum:
              - zhihe,a210-melonpi-v1
              - zhihe,a210-melonpi-v2
          - const: zhihe,a210-som
          - const: zhihe,a210

additionalProperties: true

...
```

## Documentation/devicetree/bindings/soc/zhihe/zhihe,a210-peri-ctrl.yaml
```yaml
# SPDX-License-Identifier: (GPL-2.0-only OR BSD-2-Clause)
%YAML 1.2
---
$id: http://devicetree.org/schemas/soc/zhihe/zhihe,a210-peri-ctrl.yaml#
$schema: http://devicetree.org/meta-schemas/core.yaml#

title: Zhihe A210 peripheral control registers

maintainers:
  - Han Gao <gaohan@iscas.ac.cn>

description:
  Peripheral subsystem control registers contain I2S enable and status
  bits, and CAN low-power controls. Clock gates and resets are separate
  register banks.

properties:
  compatible:
    items:
      - const: zhihe,a210-peri2-ctrl
      - const: syscon
  reg:
    maxItems: 1

required:
  - compatible
  - reg

additionalProperties: false

examples:
  - |
    syscon@8400000 {
        compatible = "zhihe,a210-peri2-ctrl", "syscon";
        reg = <0x8400000 0x8>;
    };
...
```
