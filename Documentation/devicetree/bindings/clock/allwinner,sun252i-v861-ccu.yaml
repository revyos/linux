## Documentation/devicetree/bindings/sound/everest,es8156.yaml
```yaml
# SPDX-License-Identifier: (GPL-2.0-only OR BSD-2-Clause)
%YAML 1.2
---
$id: http://devicetree.org/schemas/sound/everest,es8156.yaml#
$schema: http://devicetree.org/meta-schemas/core.yaml#

title: Everest Semiconductor ES8156 stereo DAC

maintainers:
  - Han Gao <gaohan@iscas.ac.cn>

allOf:
  - $ref: dai-common.yaml#

properties:
  compatible:
    const: everest,es8156
  reg:
    maxItems: 1
  avdd-supply:
    description: Analog power supply.
  dvdd-supply:
    description: Digital core power supply.
  pvdd-supply:
    description: Digital interface power supply.
  '#sound-dai-cells':
    const: 0

required:
  - compatible
  - reg
  - avdd-supply
  - dvdd-supply
  - pvdd-supply
  - '#sound-dai-cells'

unevaluatedProperties: false

examples:
  - |
    i2c {
        #address-cells = <1>;
        #size-cells = <0>;
        codec@8 {
            compatible = "everest,es8156";
            reg = <8>;
            avdd-supply = <&vdd_3v3>;
            dvdd-supply = <&vdd_1v8>;
            pvdd-supply = <&vdd_1v8>;
            #sound-dai-cells = <0>;
        };
    };
...
```

## Documentation/devicetree/bindings/sound/zhihe,a210-i2s.yaml
```yaml
# SPDX-License-Identifier: (GPL-2.0-only OR BSD-2-Clause)
%YAML 1.2
---
$id: http://devicetree.org/schemas/sound/zhihe,a210-i2s.yaml#
$schema: http://devicetree.org/meta-schemas/core.yaml#

title: Zhihe A210 stereo I2S controller

maintainers:
  - Han Gao <gaohan@iscas.ac.cn>

allOf:
  - $ref: dai-common.yaml#

properties:
  compatible:
    const: zhihe,a210-i2s
  reg:
    maxItems: 1
  interrupts:
    maxItems: 1
  clocks:
    maxItems: 2
  clock-names:
    items:
      - const: pclk
      - const: mclk
  resets:
    maxItems: 1
  power-domains:
    maxItems: 1
  dmas:
    maxItems: 2
  dma-names:
    items:
      - const: tx
      - const: rx
  zhihe,syscon:
    description: Peripheral system control register and I2S enable bit.
    $ref: /schemas/types.yaml#/definitions/phandle-array
    items:
      - items:
          - description: Phandle to the peripheral control registers.
          - description: Offset of the I2S control register.
          - description: Mask of the controller enable bit.
  '#sound-dai-cells':
    const: 0

required:
  - compatible
  - reg
  - clocks
  - clock-names
  - resets
  - dmas
  - dma-names
  - zhihe,syscon
  - '#sound-dai-cells'

unevaluatedProperties: false

examples:
  - |
    i2s@840a000 {
        compatible = "zhihe,a210-i2s";
        reg = <0x840a000 0x1000>;
        clocks = <&clk 1>, <&clk 2>;
        clock-names = "pclk", "mclk";
        resets = <&rst 1>;
        zhihe,syscon = <&peri2_ctrl 0 0x1>;
        dmas = <&dma 38>, <&dma 37>;
        dma-names = "tx", "rx";
        #sound-dai-cells = <0>;
    };
...
```

## Documentation/devicetree/bindings/spi/allwinner,sun252i-v861-spif.yaml
```yaml
# SPDX-License-Identifier: (GPL-2.0-only OR BSD-2-Clause)
%YAML 1.2
---
$id: http://devicetree.org/schemas/spi/allwinner,sun252i-v861-spif.yaml#
$schema: http://devicetree.org/meta-schemas/core.yaml#

title: Allwinner V861 dedicated SPI flash controller

maintainers:
  - Han Gao <gaohan@iscas.ac.cn>

allOf:
  - $ref: spi-controller.yaml#

properties:
  compatible:
    const: allwinner,sun252i-v861-spif

  reg:
    maxItems: 1

  interrupts:
    maxItems: 1

  clocks:
    items:
      - description: Bus clock
      - description: Module clock

  clock-names:
    items:
      - const: ahb
      - const: mod

  resets:
    maxItems: 1

required:
  - compatible
  - reg
  - interrupts
  - clocks
  - clock-names
  - resets

unevaluatedProperties: false

examples:
  - |
    #include <dt-bindings/clock/sun252i-v861-ccu.h>
    #include <dt-bindings/interrupt-controller/irq.h>
    #include <dt-bindings/reset/sun252i-v861-ccu.h>

    spi@4f00000 {
        compatible = "allwinner,sun252i-v861-spif";
        reg = <0x04f00000 0x1000>;
        interrupts = <19 IRQ_TYPE_LEVEL_HIGH>;
        clocks = <&ccu CLK_BUS_SPIF>, <&ccu CLK_SPIF>;
        clock-names = "ahb", "mod";
        resets = <&ccu RST_BUS_SPIF>;
        #address-cells = <1>;
        #size-cells = <0>;
    };
```

## arch/riscv/configs/defconfig
```kconfig
# CONFIG_LOCALVERSION_AUTO is not set
CONFIG_SYSVIPC=y
CONFIG_POSIX_MQUEUE=y
CONFIG_NO_HZ_IDLE=y
CONFIG_HIGH_RES_TIMERS=y
CONFIG_BPF_SYSCALL=y
CONFIG_IKCONFIG=y
CONFIG_IKCONFIG_PROC=y
CONFIG_CGROUPS=y
CONFIG_MEMCG=y
CONFIG_CGROUP_SCHED=y
CONFIG_CFS_BANDWIDTH=y
CONFIG_RT_GROUP_SCHED=y
CONFIG_CGROUP_PIDS=y
CONFIG_CGROUP_FREEZER=y
CONFIG_CGROUP_HUGETLB=y
CONFIG_CPUSETS=y
CONFIG_CGROUP_DEVICE=y
CONFIG_CGROUP_CPUACCT=y
CONFIG_CGROUP_PERF=y
CONFIG_CGROUP_BPF=y
CONFIG_NAMESPACES=y
CONFIG_USER_NS=y
CONFIG_CHECKPOINT_RESTORE=y
CONFIG_BLK_DEV_INITRD=y
CONFIG_EXPERT=y
# CONFIG_SYSFS_SYSCALL is not set
CONFIG_PROFILING=y
CONFIG_SOC_MICROCHIP_POLARFIRE=y
CONFIG_ARCH_RENESAS=y
CONFIG_SOC_SIFIVE=y
CONFIG_ARCH_SOPHGO=y
CONFIG_SOC_STARFIVE=y
CONFIG_ARCH_SUNXI=y
CONFIG_ARCH_THEAD=y
CONFIG_SOC_VIRT=y
CONFIG_SMP=y
CONFIG_RELOCATABLE=y
CONFIG_VIRTUALIZATION=y
CONFIG_KVM=m
CONFIG_ACPI=y
CONFIG_ACPI_CONTAINER=y
CONFIG_JUMP_LABEL=y
CONFIG_MODULES=y
CONFIG_MODULE_UNLOAD=y
CONFIG_SPARSEMEM_MANUAL=y
CONFIG_NET=y
CONFIG_PACKET=y
CONFIG_XFRM_USER=m
CONFIG_IP_MULTICAST=y
CONFIG_IP_ADVANCED_ROUTER=y
CONFIG_IP_PNP=y
CONFIG_IP_PNP_DHCP=y
CONFIG_IP_PNP_BOOTP=y
CONFIG_IP_PNP_RARP=y
CONFIG_INET_ESP=m
CONFIG_NETFILTER=y
CONFIG_BRIDGE_NETFILTER=m
CONFIG_NF_CONNTRACK=m
CONFIG_NF_CONNTRACK_FTP=m
CONFIG_NF_CONNTRACK_TFTP=m
CONFIG_NETFILTER_XT_MARK=m
CONFIG_NETFILTER_XT_MATCH_ADDRTYPE=m
CONFIG_NETFILTER_XT_MATCH_CONNTRACK=m
CONFIG_NETFILTER_XT_MATCH_IPVS=m
CONFIG_IP_VS=m
CONFIG_IP_VS_PROTO_TCP=y
CONFIG_IP_VS_PROTO_UDP=y
CONFIG_IP_VS_RR=m
CONFIG_IP_VS_NFCT=y
CONFIG_NF_LOG_ARP=m
CONFIG_NF_LOG_IPV4=m
CONFIG_IP_NF_IPTABLES=m
CONFIG_IP_NF_FILTER=m
CONFIG_IP_NF_TARGET_REJECT=m
CONFIG_IP_NF_NAT=m
CONFIG_IP_NF_TARGET_MASQUERADE=m
CONFIG_IP_NF_TARGET_REDIRECT=m
CONFIG_IP_NF_MANGLE=m
CONFIG_NF_LOG_IPV6=m
CONFIG_IP6_NF_IPTABLES=m
CONFIG_IP6_NF_MATCH_IPV6HEADER=m
CONFIG_IP6_NF_FILTER=m
CONFIG_IP6_NF_TARGET_REJECT=m
CONFIG_IP6_NF_MANGLE=m
CONFIG_BRIDGE=m
CONFIG_BRIDGE_VLAN_FILTERING=y
CONFIG_VLAN_8021Q=m
CONFIG_NET_SCHED=y
CONFIG_NET_CLS_CGROUP=m
CONFIG_NETLINK_DIAG=y
CONFIG_CGROUP_NET_PRIO=y
CONFIG_NET_9P=y
CONFIG_NET_9P_VIRTIO=y
CONFIG_PCI=y
CONFIG_PCIEPORTBUS=y
CONFIG_PCIEAER=y
CONFIG_PCIEAER_INJECT=m
CONFIG_PCIE_ECRC=y
CONFIG_PCIE_DPC=y
CONFIG_PCIE_PTM=y
CONFIG_PCIE_EDR=y
CONFIG_PCI_DYNAMIC_OF_NODES=y
CONFIG_PCI_HOST_GENERIC=y
CONFIG_PCIE_XILINX=y
CONFIG_PCIE_SG2042_HOST=y
CONFIG_PCIE_FU740=y
CONFIG_PCIE_SOPHGO_DW=y
CONFIG_DEVTMPFS=y
CONFIG_DEVTMPFS_MOUNT=y
CONFIG_MTD=m
CONFIG_MTD_SPI_NOR=m
CONFIG_BLK_DEV_LOOP=y
CONFIG_VIRTIO_BLK=y
CONFIG_BLK_DEV_NVME=m
CONFIG_NVME_MULTIPATH=y
CONFIG_NVME_HWMON=y
CONFIG_BLK_DEV_SD=y
CONFIG_BLK_DEV_SR=y
CONFIG_SCSI_VIRTIO=y
CONFIG_ATA=y
CONFIG_SATA_AHCI=y
CONFIG_SATA_AHCI_PLATFORM=y
CONFIG_MD=y
CONFIG_BLK_DEV_DM=m
CONFIG_DM_THIN_PROVISIONING=m
CONFIG_NETDEVICES=y
CONFIG_DUMMY=m
CONFIG_MACVLAN=m
CONFIG_IPVLAN=m
CONFIG_VXLAN=m
CONFIG_VETH=m
CONFIG_VIRTIO_NET=y
CONFIG_MACB=y
CONFIG_E100=m
CONFIG_E1000=m
CONFIG_E1000E=m
CONFIG_IGB=m
CONFIG_IGBVF=m
CONFIG_IXGBE=m
CONFIG_IXGBEVF=m
CONFIG_I40E=m
CONFIG_I40EVF=m
CONFIG_ICE=m
CONFIG_FM10K=m
CONFIG_IGC=m
CONFIG_R8169=y
CONFIG_STMMAC_ETH=y
CONFIG_DWMAC_GENERIC=m
CONFIG_DWMAC_SOPHGO=y
CONFIG_MICROSEMI_PHY=y
CONFIG_INPUT_MOUSEDEV=y
CONFIG_KEYBOARD_SUN4I_LRADC=m
CONFIG_SERIAL_8250=y
CONFIG_SERIAL_8250_CONSOLE=y
CONFIG_SERIAL_8250_DW=y
CONFIG_SERIAL_OF_PLATFORM=y
CONFIG_SERIAL_SH_SCI=y
CONFIG_VIRTIO_CONSOLE=y
CONFIG_HW_RANDOM=y
CONFIG_HW_RANDOM_VIRTIO=y
CONFIG_I2C_CHARDEV=m
CONFIG_I2C_MUX=m
CONFIG_I2C_ARB_GPIO_CHALLENGE=m
CONFIG_I2C_MUX_GPIO=m
CONFIG_I2C_MUX_GPMUX=m
CONFIG_I2C_MUX_LTC4306=m
CONFIG_I2C_MUX_PCA9541=m
CONFIG_I2C_MUX_PCA954x=m
CONFIG_I2C_MUX_PINCTRL=m
CONFIG_I2C_MUX_REG=m
CONFIG_I2C_DEMUX_PINCTRL=m
CONFIG_I2C_MUX_MLXCPLD=m
CONFIG_I2C_DESIGNWARE_SLAVE=y
CONFIG_I2C_DESIGNWARE_PLATFORM=m
CONFIG_I2C_DESIGNWARE_PCI=m
CONFIG_I2C_MV64XXX=m
CONFIG_SPI=y
CONFIG_SPI_SIFIVE=y
CONFIG_SPI_SG2044_NOR=y
CONFIG_SPI_SUN6I=y
# CONFIG_PTP_1588_CLOCK is not set
CONFIG_PINCTRL_SOPHGO_CV1800B=y
CONFIG_PINCTRL_SOPHGO_CV1812H=y
CONFIG_PINCTRL_SOPHGO_SG2000=y
CONFIG_PINCTRL_SOPHGO_SG2002=y
CONFIG_PINCTRL_SOPHGO_SG2042=y
CONFIG_PINCTRL_SOPHGO_SG2044=y
CONFIG_GPIO_DWAPB=m
CONFIG_GPIO_GENERIC_PLATFORM=m
CONFIG_GPIO_SIFIVE=y
CONFIG_GPIO_PCA953X=m
CONFIG_GPIO_PCA953X_IRQ=y
CONFIG_SENSORS_PWM_FAN=y
CONFIG_SENSORS_SG2042_MCU=m
CONFIG_THERMAL_WRITABLE_TRIPS=y
CONFIG_THERMAL_GOV_USER_SPACE=y
CONFIG_WATCHDOG=y
CONFIG_SUNXI_WATCHDOG=y
CONFIG_REGULATOR=y
CONFIG_REGULATOR_FIXED_VOLTAGE=y
CONFIG_REGULATOR_PWM=y
CONFIG_DRM=m
CONFIG_DRM_RADEON=m
CONFIG_DRM_NOUVEAU=m
CONFIG_DRM_SUN4I=m
CONFIG_DRM_VIRTIO_GPU=m
CONFIG_FB=y
CONFIG_BACKLIGHT_PWM=m
CONFIG_USB=y
CONFIG_USB_XHCI_HCD=y
CONFIG_USB_XHCI_PLATFORM=y
CONFIG_USB_EHCI_HCD=y
CONFIG_USB_EHCI_HCD_PLATFORM=y
CONFIG_USB_OHCI_HCD=y
CONFIG_USB_OHCI_HCD_PLATFORM=y
CONFIG_USB_STORAGE=y
CONFIG_USB_UAS=y
CONFIG_USB_MUSB_HDRC=m
CONFIG_USB_MUSB_SUNXI=m
CONFIG_NOP_USB_XCEIV=m
CONFIG_MMC=y
CONFIG_MMC_SDHCI=y
CONFIG_MMC_SDHCI_PLTFM=y
CONFIG_MMC_SDHCI_OF_DWCMSHC=y
CONFIG_MMC_SDHCI_CADENCE=y
CONFIG_MMC_SPI=y
CONFIG_MMC_DW=m
CONFIG_MMC_USHC=m
CONFIG_MMC_SUNXI=y
CONFIG_RTC_CLASS=y
CONFIG_RTC_DRV_SUN6I=y
CONFIG_DMADEVICES=y
CONFIG_DMA_SUN6I=m
CONFIG_VIRTIO_PCI=y
CONFIG_VIRTIO_BALLOON=y
CONFIG_VIRTIO_INPUT=y
CONFIG_VIRTIO_MMIO=y
CONFIG_COMMON_CLK_PWM=y
CONFIG_CLK_SOPHGO_CV1800=y
CONFIG_CLK_SOPHGO_SG2042_PLL=y
CONFIG_CLK_SOPHGO_SG2042_CLKGEN=y
CONFIG_CLK_SOPHGO_SG2042_RPGATE=y
CONFIG_CLK_SOPHGO_SG2044=y
CONFIG_CLK_SOPHGO_SG2044_PLL=y
CONFIG_SUN8I_DE2_CCU=m
CONFIG_SUN50I_IOMMU=y
CONFIG_RPMSG_CHAR=y
CONFIG_RPMSG_CTRL=y
CONFIG_RPMSG_VIRTIO=y
CONFIG_SOPHGO_SG2044_TOPSYS=y
CONFIG_PWM=y
CONFIG_PWM_CLK=y
CONFIG_PWM_DWC=y
CONFIG_PWM_SOPHGO_SG2042=y
CONFIG_ACLINT_SSWI=y
CONFIG_SOPHGO_SG2042_MSI=y
CONFIG_PHY_SUN4I_USB=m
CONFIG_LIBNVDIMM=y
CONFIG_NVMEM_SUNXI_SID=y
CONFIG_EXT4_FS=y
CONFIG_EXT4_FS_POSIX_ACL=y
CONFIG_EXT4_FS_SECURITY=y
CONFIG_BTRFS_FS=m
CONFIG_BTRFS_FS_POSIX_ACL=y
CONFIG_AUTOFS_FS=y
CONFIG_OVERLAY_FS=m
CONFIG_ISO9660_FS=y
CONFIG_JOLIET=y
CONFIG_ZISOFS=y
CONFIG_MSDOS_FS=y
CONFIG_VFAT_FS=y
CONFIG_TMPFS=y
CONFIG_TMPFS_POSIX_ACL=y
CONFIG_HUGETLBFS=y
CONFIG_NFS_FS=y
CONFIG_NFS_V4=y
CONFIG_NFS_V4_1=y
CONFIG_NFS_V4_2=y
CONFIG_ROOT_NFS=y
CONFIG_9P_FS=y
CONFIG_NLS_CODEPAGE_437=y
CONFIG_NLS_ISO8859_1=m
CONFIG_SECURITY=y
CONFIG_SECURITY_SELINUX=y
CONFIG_SECURITY_APPARMOR=y
CONFIG_DEFAULT_SECURITY_DAC=y
CONFIG_CRYPTO_USER_API_HASH=y
CONFIG_CRYPTO_DEV_VIRTIO=y
CONFIG_PRINTK_TIME=y
CONFIG_DEBUG_FS=y
CONFIG_DEBUG_PAGEALLOC=y
CONFIG_SCHED_STACK_END_CHECK=y
CONFIG_DEBUG_VM=y
CONFIG_DEBUG_VM_PGFLAGS=y
CONFIG_DEBUG_MEMORY_INIT=y
CONFIG_DEBUG_PER_CPU_MAPS=y
CONFIG_SOFTLOCKUP_DETECTOR=y
CONFIG_WQ_WATCHDOG=y
CONFIG_DEBUG_TIMEKEEPING=y
CONFIG_DEBUG_RT_MUTEXES=y
CONFIG_DEBUG_SPINLOCK=y
CONFIG_DEBUG_MUTEXES=y
CONFIG_DEBUG_RWSEMS=y
CONFIG_DEBUG_ATOMIC_SLEEP=y
CONFIG_DEBUG_LIST=y
CONFIG_DEBUG_PLIST=y
CONFIG_DEBUG_SG=y
# CONFIG_RCU_TRACE is not set
CONFIG_RCU_EQS_DEBUG=y
# CONFIG_FTRACE is not set
# CONFIG_RUNTIME_TESTING_MENU is not set
CONFIG_MEMTEST=y
```

## drivers/firmware/zhihe/Kconfig
```kconfig
# SPDX-License-Identifier: GPL-2.0-only
config ZHIHE_A210_AON
	tristate "ZhiHe A210 AON protocol driver"
	depends on ZHIHE_A210_MBOX
	select AUXILIARY_BUS
	help
	  ZhiHe AON is a low-level system function which runs a dedicated
	  ZhiHe RISC-V E902 core to provide power, clock and resource management.

	  This driver manages the IPC interface between the host CPU and the
	  AON firmware running on the ZhiHe RISC-V E902 core.
```

## drivers/phy/zhihe/Kconfig
```kconfig
# SPDX-License-Identifier: GPL-2.0-only
config PHY_ZHIHE_A210_E16
	tristate "Zhihe A210 E16 PCIe PHY"
	depends on ARCH_ZHIHE || COMPILE_TEST
	depends on OF && COMMON_CLK
	select GENERIC_PHY
	help
	  Enable the shared Synopsys E16 PHY for the A210 PCIe root ports.
	  The driver configures lane routing and analog calibration using
	  the board reference clock. Both root ports share the PHY lifetime.
	  Say Y or M when using PCIe on a Zhihe A210 board.

config PHY_ZHIHE_A210_USB2
	tristate "Zhihe A210 USB2 PHY"
	depends on ARCH_ZHIHE || COMPILE_TEST
	depends on OF && COMMON_CLK
	select GENERIC_PHY
	select USB_COMMON
	help
	  Enable the two USB2 femtoPHY instances on the Zhihe A210.
	  Each PHY uses the connected controller's fixed host or device
	  role. Clock and reset resources are managed independently.
	  Say Y or M for boards using the A210 DWC2 controllers.
```

## sound/soc/thead/Kconfig
```kconfig
# SPDX-License-Identifier: GPL-2.0-only
config SND_SOC_THEAD_I2S
	tristate "T-Head stereo I2S controller"
	depends on ARCH_ZHIHE || COMPILE_TEST
	depends on COMMON_CLK && DMADEVICES && OF
	select MFD_SYSCON
	select SND_SOC_GENERIC_DMAENGINE_PCM
	help
	  Enable the stereo I2S controller used by the Zhihe A210 SoC.
	  Audio transfers use the standard DMAengine PCM interface.

	  To compile this driver as a module, choose M here. The module
	  will be called thead-i2s.
```
